/*
 * Copyright (c) 2022 Gabriel Hansson
 *
 * SPDX-License-Identifier: MIT
 */

#include "borne.dtsi"

&kscan0 {
    // &gpio[0,1] are specific to the nrf plattform
    input-gpios = 
        <&gpio1 9 (GPIO_ACTIVE_LOW | GPIO_PULL_UP)>,
        <&gpio0 24 (GPIO_ACTIVE_LOW | GPIO_PULL_UP)>,
        <&gpio0 25 (GPIO_ACTIVE_LOW | GPIO_PULL_UP)>,
        <&gpio1 2 (GPIO_ACTIVE_LOW | GPIO_PULL_UP)>,
        <&gpio0 31 (GPIO_ACTIVE_LOW | GPIO_PULL_UP)>,
        <&gpio0 8 (GPIO_ACTIVE_LOW | GPIO_PULL_UP)>,
        <&gpio0 22 (GPIO_ACTIVE_LOW | GPIO_PULL_UP)>,
        <&gpio1 4 (GPIO_ACTIVE_LOW | GPIO_PULL_UP)>,
        <&gpio0 9 (GPIO_ACTIVE_LOW | GPIO_PULL_UP)>,
        <&gpio0 29 (GPIO_ACTIVE_LOW | GPIO_PULL_UP)>,
        <&gpio0 6 (GPIO_ACTIVE_LOW | GPIO_PULL_UP)>,
        <&gpio0 20 (GPIO_ACTIVE_LOW | GPIO_PULL_UP)>,
        <&gpio1 6 (GPIO_ACTIVE_LOW | GPIO_PULL_UP)>,
        <&gpio0 10 (GPIO_ACTIVE_LOW | GPIO_PULL_UP)>,
        <&gpio0 2 (GPIO_ACTIVE_LOW | GPIO_PULL_UP)>,
        <&gpio1 10 (GPIO_ACTIVE_LOW | GPIO_PULL_UP)>,
        <&gpio1 13 (GPIO_ACTIVE_LOW | GPIO_PULL_UP)>,
        <&gpio1 15 (GPIO_ACTIVE_LOW | GPIO_PULL_UP)>
    ;
};
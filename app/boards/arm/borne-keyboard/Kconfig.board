## app/boards/arm/borne-keyboard/Kconfig.board
```kconfig
# Copyright (c) 2022 Gabriel Hansson
# SPDX-License-Identifier: MIT

config BOARD_BORNE
	bool "borne"
	depends on SOC_NRF52840_QIAA
```

## app/boards/arm/borne-keyboard/Kconfig.defconfig
```kconfig
# Copyright (c) 2022 Gabriel Hansson
# SPDX-License-Identifier: MIT

if BOARD_BORNE
	config BT_CTLR
		default BT
	config ZMK_BLE
		default y
	config ZMK_USB
		default y

	if USB_DEVICE_STACK
		config USB_NRFX
			 default y
	endif

	config PINMUX
		default y

	choice BOARD_BORNE_CHARGER_CURRENT
		default BOARD_BORNE_CHARGER_CURRENT_100MA
	endchoice
endif
```

## app/boards/arm/borne-keyboard/Kconfig.shield
```kconfig
# Copyright (c) 2022 Gabriel Hansson
# SPDX-License-Identifier: MIT

config SHIELD_BORNE_LEFT
	def_bool $(shields_list_contains,borne_left)

config SHIELD_BORNE_RIGHT
	def_bool $(shields_list_contains,borne_right)
```

## app/boards/arm/borne-keyboard/borne_defconfig
```kconfig
# Copyright (c) 2022 Gabriel Hansson
# SPDX-License-Identifier: MIT

CONFIG_SOC_SERIES_NRF52X=y
CONFIG_SOC_NRF52840_QIAA=y
CONFIG_BOARD_BORNE=y
CONFIG_ARM_MPU=y

CONFIG_USE_DT_CODE_PARTITION=y
CONFIG_GPIO=y

CONFIG_BUILD_OUTPUT_UF2=y
CONFIG_MPU_ALLOW_FLASH_WRITE=y
CONFIG_NVS=y
CONFIG_SETTINGS_NVS=y
CONFIG_FLASH=y
CONFIG_FLASH_PAGE_LAYOUT=y
CONFIG_FLASH_MAP=y

# Deep sleep
# https://zmk.dev/docs/config/power#kconfig
CONFIG_ZMK_SLEEP=y
# CONFIG_ZMK_IDLE_SLEEP_TIMEOUT=9000000
```

## app/boards/shields/borne-keyboard/Kconfig.defconfig
```kconfig
# Copyright (c) 2022 Gabriel Hansson
# SPDX-License-Identifier: MIT

if SHIELD_BORNE_LEFT
	config ZMK_KEYBOARD_NAME 
		default "Borne Keyboard"
	config ZMK_SPLIT_ROLE_CENTRAL
		default y
endif

if SHIELD_BORNE_LEFT || SHIELD_BORNE_RIGHT
	config ZMK_SPLIT
		default y
endif
```

## app/boards/shields/borne-keyboard/Kconfig.shield
```kconfig
config SHIELD_BORNE_LEFT
	# argument in weston build command
    def_bool $(shields_list_contains,borne_left)

config SHIELD_BORNE_RIGHT
    def_bool $(shields_list_contains,borne_right)
```

## app/build/left/Kconfig/Kconfig.modules
```kconfig
menu "CANopenNode (/home/gibbz/projects/under-construction/borne-keyboard/firmware/zmk/modules/lib/canopennode)"
osource "$(ZEPHYR_CANOPENNODE_KCONFIG)"
config ZEPHYR_CANOPENNODE_MODULE
	bool
	default y
endmenu
menu "hal_gigadevice (/home/gibbz/projects/under-construction/borne-keyboard/firmware/zmk/modules/hal/gigadevice)"
osource "$(ZEPHYR_HAL_GIGADEVICE_KCONFIG)"
config ZEPHYR_HAL_GIGADEVICE_MODULE
	bool
	default y
endmenu
menu "hal_nordic (/home/gibbz/projects/under-construction/borne-keyboard/firmware/zmk/modules/hal/nordic)"
osource "$(ZEPHYR_HAL_NORDIC_KCONFIG)"
config ZEPHYR_HAL_NORDIC_MODULE
	bool
	default y
endmenu
menu "hal_rpi_pico (/home/gibbz/projects/under-construction/borne-keyboard/firmware/zmk/modules/hal/rpi_pico)"
osource "$(ZEPHYR_HAL_RPI_PICO_KCONFIG)"
config ZEPHYR_HAL_RPI_PICO_MODULE
	bool
	default y
endmenu
menu "lz4 (/home/gibbz/projects/under-construction/borne-keyboard/firmware/zmk/modules/lib/lz4)"
osource "$(ZEPHYR_LZ4_KCONFIG)"
config ZEPHYR_LZ4_MODULE
	bool
	default y
endmenu
menu "mbedtls (/home/gibbz/projects/under-construction/borne-keyboard/firmware/zmk/modules/crypto/mbedtls)"
osource "$(ZEPHYR_MBEDTLS_KCONFIG)"
config ZEPHYR_MBEDTLS_MODULE
	bool
	default y
endmenu
menu "nanopb (/home/gibbz/projects/under-construction/borne-keyboard/firmware/zmk/modules/lib/nanopb)"
osource "$(ZEPHYR_NANOPB_KCONFIG)"
config ZEPHYR_NANOPB_MODULE
	bool
	default y
endmenu
menu "tflite-micro (/home/gibbz/projects/under-construction/borne-keyboard/firmware/zmk/modules/lib/tflite-micro)"
osource "$(ZEPHYR_TFLITE_MICRO_KCONFIG)"
config ZEPHYR_TFLITE_MICRO_MODULE
	bool
	default y
endmenu
menu "TraceRecorder (/home/gibbz/projects/under-construction/borne-keyboard/firmware/zmk/modules/debug/TraceRecorder)"
osource "/home/gibbz/projects/under-construction/borne-keyboard/firmware/zmk/modules/debug/TraceRecorder/kernelports/Zephyr/Kconfig"
config ZEPHYR_TRACERECORDER_MODULE
	bool
	default y
endmenu
menu "zscilib (/home/gibbz/projects/under-construction/borne-keyboard/firmware/zmk/modules/lib/zscilib)"
osource "/home/gibbz/projects/under-construction/borne-keyboard/firmware/zmk/modules/lib/zscilib/Kconfig.zscilib"
config ZEPHYR_ZSCILIB_MODULE
	bool
	default y
endmenu
menu "drivers (/home/gibbz/projects/under-construction/borne-keyboard/firmware/zmk/app/drivers)"
osource "/home/gibbz/projects/under-construction/borne-keyboard/firmware/zmk/app/drivers/Kconfig"
config ZEPHYR_DRIVERS_MODULE
	bool
	default y
endmenu
```

## app/build/left/Kconfig/Kconfig.shield
```kconfig
osource "/home/gibbz/projects/under-construction/borne-keyboard/firmware/zmk/app/boards/shields/*/Kconfig.shield"
```
